int sensorvalue = 0;
int buzzer = 6;


#include <SPI.h>
#include <Wire.h>
#include <Adafruit_GFX.h>
#include <Adafruit_SSD1306.h>

#define SCREEN_WIDTH 128 // OLED display width, in pixels
#define SCREEN_HEIGHT 64 // OLED display height, in pixels


#define OLED_RESET     -1 // Reset pin # (or -1 if sharing Arduino reset pin)
#define SCREEN_ADDRESS 0x3C ///< See datasheet for Address; 0x3D for 128x64, 0x3C for 128x32
Adafruit_SSD1306 display(SCREEN_WIDTH, SCREEN_HEIGHT, &Wire, OLED_RESET);

static const uint8_t  PROGMEM image_data_20190410_114707[] = {
  0x00, 0x00, 0x00, 0x00, 0x00, 0x00, 0x00, 0x00, 0x00, 0x00, 0x00, 0x00, 0x00, 0x00, 0x00, 0x00,
  0x00, 0x00, 0x00, 0x00, 0x00, 0x00, 0x00, 0x00, 0x00, 0x00, 0x00, 0x00, 0x00, 0x00, 0x00, 0x00,
  0x00, 0x00, 0x00, 0x00, 0x00, 0x00, 0x00, 0x00, 0x00, 0x00, 0x00, 0x00, 0x00, 0x00, 0x00, 0x00,
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  0x00, 0x00, 0x00, 0x00, 0x00, 0x00, 0x00, 0x00, 0x00, 0x00, 0x00, 0x00, 0x00, 0x00, 0x00, 0x00
};


void setup() {
  pinMode(A3,INPUT);
  Serial.begin(9600);
  pinMode(buzzer,OUTPUT);

    // SSD1306_SWITCHCAPVCC = generate display voltage from 3.3V internally
  if(!display.begin(SSD1306_SWITCHCAPVCC, SCREEN_ADDRESS)) {
    Serial.println(F("SSD1306 allocation failed"));
    for(;;); // Don't proceed, loop forever
  }
  delay(2000); // Pause for 2 seconds
 
  // Clear the buffer.
  display.clearDisplay();
  
  // Draw bitmap on the screen
  display.drawBitmap(0, 0, image_data_20190410_114707, 128, 64, 1);
  display.display();
  delay(2000);
  display.clearDisplay();
  display.setTextColor(WHITE);

}

void loop() {
  sensorvalue = analogRead(A3);
  Serial.print("Sensor value =");
  Serial.print(sensorvalue);
  Serial.print('\n');
  delay(1000);

  display.clearDisplay();
  display.setCursor(10,1);
  display.setTextSize(2);
  display.print("CORECHAMP");
  delay(100);
  display.setCursor(10,55);
  display.setTextSize(1);
  display.print("SENSOR VALUE: "); 
  delay(100);
  display.print(sensorvalue);
  delay(100);
  if(sensorvalue <33){
    Serial.print(" Very Good air quality");
    digitalWrite(buzzer,LOW);
    display.setCursor(0,30);
    display.setTextSize(1);
    display.print("Very Good air quality");
    }
    else if(sensorvalue <=66){
      Serial.println("Good air quality");
      digitalWrite(buzzer,LOW);
      display.setCursor(0,30);
      display.setTextSize(1);
      display.print("Good air quality");
      }
      else if(sensorvalue <=99){
        Serial.println("Normal air quality");
        digitalWrite(buzzer,LOW);
        display.setCursor(0,30);
        display.setTextSize(1);
        display.print("Normal air quality");
        }
        else if(sensorvalue <=149){
        Serial.println("Poor air quality");
        digitalWrite(buzzer,LOW);  
        display.setCursor(0,30);
        display.setTextSize(1);
        display.print("Poor air quality");
        }
        else if(sensorvalue <=200){
        Serial.println("Very Poor air quality");
        digitalWrite(buzzer,HIGH);
        display.setCursor(0,30);
        display.setTextSize(1);
        display.print("Very poor air quality");
        }
        else if(sensorvalue >200){
        Serial.println("Hazardous air quality");
        digitalWrite(buzzer,HIGH);
        display.setCursor(0,30);
        display.setTextSize(1);
        display.print("Hazardous air quality");
        }
  
  display.display();

  delay(2000);
        
 }
  
